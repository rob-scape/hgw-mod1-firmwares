/*
Dual AD envelope for Mod1 module designed by HAGIWO, adapted by Rob Heel.

Two independent Attack–Decay envelopes with shared attack and release knobs.
Per-envelope random timing variation via Pot3 (A2): 
 • Fully CCW → no variation
 • Fully CW → max random deviation per trigger
Variations are stronger at shorter attack/release settings, lighter at longer ones.

Envelope 1 is also manually triggerable via push button.
LED indicates envelope 1 level.

Outputs are fast PWM (16-bit for ENV1/ENV2, 8-bit LED).
Designed for Eurorack/modular trigger input and CV envelope output.

--Pin assign---
POT1  A0  Attack time
POT2  A1  Release Time
POT3  A2  Variation amount

F1    D17 Trigger1 IN
F2    D9  envelope1 out

F3    D10 Trigger2 IN
F4    D11 envelope2 out
BUTTON    Trigger envelope1
LED       output envelope1
EEPROM    N/A

*/
#define TABLE_SIZE 1024
#define Brightness 160  //0 - 255

const static PROGMEM byte Curve[1024] = {
  255, 254, 253, 252, 251, 250, 249, 248, 247, 246, 245, 244,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 0
};

const static PROGMEM int PotAdjust[1024] = {
  0, 5, 10, 15, 20, 25, 30, 35, 39, 44, 49, 54,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 1023
};



float waveIndex1 = 0, waveIndex2 = 0;
int outputValue1 = 0, outputValue2 = 0;
int lastout1 = 0, lastout2 = 0;
unsigned long previousMillis = 0, currentMillis = 0;
bool lastTrig1 = HIGH, lastTrig2 = HIGH;
int state1 = 0, state2 = 0;
bool EoC1 = 0, EoC2 = 0;
int EoCcount1 = 0, EoCcount2 = 0;
int atkTime = 0, relTime = 0;
int atkTime1 = 0, relTime1 = 0;
int atkTime2 = 0, relTime2 = 0;

int lastButton = HIGH;
int lastTrig1Pin = HIGH;

void setup() {
  Serial.begin(9600);
  pinMode(4, INPUT_PULLUP);  // button
  pinMode(17, INPUT);        // trigger1
  pinMode(10, INPUT);        // trigger2
  pinMode(3, OUTPUT);        // LED
  pinMode(9, OUTPUT);        // env1 out
  pinMode(11, OUTPUT);       // env2 out

  // Fast PWM setup
  TCCR2A = (1 << WGM21) | (1 << WGM20) | (1 << COM2B1);
  TCCR2B = (1 << CS20);
  TCCR1A = (1 << WGM11) | (1 << COM1A1);
  TCCR1B = (1 << WGM13) | (1 << WGM12) | (1 << CS10);
  ICR1 = 255;
}

void loop() {
  currentMillis = millis();

  // Read pots
  int pot1 = analogRead(A0);
  int pot2 = analogRead(A1);
  int variationPot = analogRead(A2);

  atkTime = 1024 - pgm_read_word(&PotAdjust[pot1]);
  relTime = 1024 - pgm_read_word(&PotAdjust[pot2]);

  // Normalized pot values
  float atkNorm = pot1 / 1023.0;
  float relNorm = pot2 / 1023.0;
  float varNorm = variationPot / 1023.0;

  // Scaled variation range (0.2 to 0.8)
  // To shift the range to 0.1–0.8, replace 0.6 + 0.2 with 0.7 + 0.1
  float atkVarScale = (1.0 - atkNorm) * 0.6 + 0.2;
  float relVarScale = (1.0 - relNorm) * 0.6 + 0.2;
  float atkVarAmount = varNorm * atkVarScale;
  float relVarAmount = varNorm * relVarScale;

  // Trigger reads with edge detection
  int buttonReading = digitalRead(4);
  int trig1Reading = digitalRead(17);
  int trig2Reading = digitalRead(10);

  bool triggerEnvelope1 = (lastButton == HIGH && buttonReading == LOW) ||
                          (lastTrig1Pin == HIGH && trig1Reading == LOW);
  bool triggerEnvelope2 = (lastTrig2 == HIGH && trig2Reading == LOW);

  lastButton = buttonReading;
  lastTrig1Pin = trig1Reading;
  lastTrig2 = trig2Reading;

  if (triggerEnvelope1) {
    lastout1 = (state1 == 2) ? outputValue1 : 0;
    state1 = 1;
    waveIndex1 = 0;
    atkTime1 = atkTime + random(-1000, 1000) / 1000.0 * atkTime * atkVarAmount;
    relTime1 = relTime + random(-1000, 1000) / 1000.0 * relTime * relVarAmount;
  }
  if (triggerEnvelope2) {
    lastout2 = (state2 == 2) ? outputValue2 : 0;
    state2 = 1;
    waveIndex2 = 0;
    atkTime2 = atkTime + random(-1000, 1000) / 1000.0 * atkTime * atkVarAmount;
    relTime2 = relTime + random(-1000, 1000) / 1000.0 * relTime * relVarAmount;
  }

  if (currentMillis - previousMillis >= 1) {
    previousMillis = currentMillis;

    // ENV 1
    if (state1 == 1) {
      outputValue1 = map(pgm_read_byte(&Curve[(int)waveIndex1]), 0, 255, 255, lastout1);
      waveIndex1 += 0.05 * atkTime1 / 2;
    } else if (state1 == 2) {
      outputValue1 = map(pgm_read_byte(&Curve[(int)waveIndex1 - TABLE_SIZE]), 0, 255, 0, 255);
      waveIndex1 += 0.05 * relTime1 / 2;
    }
    if (waveIndex1 > TABLE_SIZE && waveIndex1 < 2 * TABLE_SIZE) state1 = 2;
    if (waveIndex1 >= 2 * TABLE_SIZE) {
      waveIndex1 = 0;
      state1 = 0;
      EoC1 = 1;
    }
    if (EoC1) {
      if (++EoCcount1 > 10) {
        EoCcount1 = 0;
        EoC1 = 0;
      }
    }
    analogWrite(9, outputValue1);
    analogWrite(3, outputValue1 * Brightness / 255);

    // ENV 2
    if (state2 == 1) {
      outputValue2 = map(pgm_read_byte(&Curve[(int)waveIndex2]), 0, 255, 255, lastout2);
      waveIndex2 += 0.05 * atkTime2 / 2;
    } else if (state2 == 2) {
      outputValue2 = map(pgm_read_byte(&Curve[(int)waveIndex2 - TABLE_SIZE]), 0, 255, 0, 255);
      waveIndex2 += 0.05 * relTime2 / 2;
    }
    if (waveIndex2 > TABLE_SIZE && waveIndex2 < 2 * TABLE_SIZE) state2 = 2;
    if (waveIndex2 >= 2 * TABLE_SIZE) {
      waveIndex2 = 0;
      state2 = 0;
      EoC2 = 1;
    }
    if (EoC2) {
      if (++EoCcount2 > 10) {
        EoCcount2 = 0;
        EoC2 = 0;
      }
    }
    analogWrite(11, outputValue2);
  }
}
